## conf/layer.conf
```bitbake
#
# Copyright (C) 2022 Wind River Systems, Inc.
#

# We have a conf and classes directory, add to BBPATH
BBPATH =. "${LAYERDIR}:"

# We have a packages directory, add to BBFILES
BBFILES += "${LAYERDIR}/recipes-*/*/*.bb \
	${LAYERDIR}/recipes-*/*/*.bbappend \
	${LAYERDIR}/classes/*.bbclass"

BBFILE_COLLECTIONS += "wr-aptiv-s32g"
BBFILE_PATTERN_wr-aptiv-s32g= "^${LAYERDIR}/"
BBFILE_PRIORITY_wr-aptiv-s32g = "7"

# This should only be incremented on significant changes that will
# cause compatibility issues with other layers
LAYERVERSION_wr-aptiv-s32g = "1"

LAYERDEPENDS_wr-aptiv-s32g = "core wrlinux wr-nxp-s32g"
LAYERSERIES_COMPAT_wr-aptiv-s32g = "wrl scarthgap"

LAYER_PATH_aptiv-s32g-layer = "${LAYERDIR}"
```

## conf/machine/aptiv-cvc-131.conf
```bitbake
#@TYPE: Machine
#@NAME: aptiv-cvc-131
#@DESCRIPTION: Machine configuration for Aptiv CVC-FL board

require conf/machine/aptiv-cvc-fl.conf
MACHINEOVERRIDES =. "aptiv-cvc-fl:"
```

## conf/machine/aptiv-cvc-fl.conf
```bitbake
#@TYPE: Machine
#@NAME: aptiv-cvc-fl
#@DESCRIPTION: Machine configuration for Aptiv CVC-FL board

require conf/machine/nxp-s32g.conf
require conf/machine/aptiv-cvc.inc

DTB_FILES = "s32g399a-cvc-fl.dtb s32g399a-cvc-fl-pfems.dtb"
UBOOT_CONFIG ??= "aptiv_cvc_fl"
UBOOT_CONFIG[aptiv_cvc_fl] = "aptiv_cvc_fl_defconfig"
IMAGE_BOOT_FILES = " ${@bb.utils.contains('ATF_SIGN_ENABLE', '1', 'fitImage', \
			'Image ${DTB_FILES}', d)}"
```

## conf/machine/aptiv-cvc.inc
```bitbake
#@TYPE: Machine inc.
#@NAME: aptiv-cvc

MACHINEOVERRIDES =. "aptiv-cvc:"

MACHINE_FEATURES:append = " hvp"
PREFERRED_VERSION_linux-yocto-rt ?= "6.6%"
PREFERRED_PROVIDER_virtual/kernel = "linux-yocto-rt"
NON_MULTILIB_RECIPES:append = " libfci libfci-cli"
```

## conf/machine/aptiv_cvc_sousa.conf
```bitbake
#@TYPE: Machine
#@NAME: aptiv_cvc_sousa
#@DESCRIPTION: Machine configuration for Aptiv CVC board

require conf/machine/nxp-s32g.conf
require conf/machine/aptiv-cvc.inc

KERNEL_DEVICETREE = "freescale/s32g274a-aptiv.dtb freescale/s32g274a-aptiv-pfems.dtb"
UBOOT_CONFIG = "aptiv_cvc_sousa"
UBOOT_CONFIG[aptiv_cvc_sousa] = "aptiv_cvc_sousa_defconfig"
IMAGE_BOOT_FILES = " ${@bb.utils.contains('ATF_SIGN_ENABLE', '1', 'fitImage', \
			'Image s32g274a-aptiv.dtb s32g274a-aptiv-pfems.dtb', d)}"
```
